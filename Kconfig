## Kconfig
```kconfig
menu "esp-mqtt"

config ESP_MQTT_ENABLED
    bool "Enable the MQTT component"
    select LWIP_SO_RCVBUF
    default y
    help
        This is currently only used to enforce the selection of LWIP_SO_RCVBUF.
        Disabling the component does not actually disable something.

config ESP_MQTT_TASK_STACK
    int "MQTT background process task stack"
        depends on ESP_MQTT_ENABLED
    default 9216
    help
        Specify at least 9216 if TLS is used and at least 4096 otherwise.

config ESP_MQTT_TASK_PRIORITY
    int "MQTT background process task priority"
    depends on ESP_MQTT_ENABLED
    default 5

config ESP_MQTT_EVENT_QUEUE_SIZE
    int "MQTT event queue size"
    depends on ESP_MQTT_ENABLED
    default 64
    help
        This value defines the amount of messages that are queued during various
        calls and dispatched by the background process.

config ESP_MQTT_TLS_ENABLE
   bool "Enable TLS connection"
   depends on ESP_MQTT_ENABLED
   default y
   help
        You can deactivate TLS to save space in memory and flash.

endmenu
```
